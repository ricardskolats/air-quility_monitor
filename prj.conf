## CMakeLists.txt
```
# SPDX-License-Identifier: Apache-2.0
# Air Quality Monitor (Thread version)

cmake_minimum_required(VERSION 3.20.0)

find_package(Zephyr REQUIRED HINTS $ENV{ZEPHYR_BASE})
project(air_quality_thread LANGUAGES C CXX)

set(CMAKE_CXX_STANDARD 17)
set(CMAKE_CXX_STANDARD_REQUIRED ON)

target_sources(app PRIVATE
    src/main.cpp
    src/Sensor.cpp
    src/Buffer.cpp
    src/Network.cpp
    src/Mqtt.cpp
)

target_include_directories(app PRIVATE src)
```

## Kconfig
```
# Air Quality Monitor - Application Kconfig

mainmenu "Air Quality Monitor Configuration"

menu "Sensor Configuration"

config AQM_SENSOR_INTERVAL_SEC
    int "Sensor read interval in seconds"
    default 300
    help
      Interval between sensor readings (default: 5 minutes = 300 seconds).

endmenu

menu "Buffer Configuration"

config AQM_BUFFER_SIZE
    int "Maximum number of samples in ring buffer"
    default 128
    help
      Maximum number of sensor samples that can be buffered.
      Each sample is approximately 16 bytes.

config AQM_BUFFER_HIGH_WATER_PERCENT
    int "High water mark percentage for early upload trigger"
    default 80
    range 50 95
    help
      When buffer fill level reaches this percentage, trigger an upload
      even if the upload interval has not elapsed.

endmenu

menu "Upload Configuration"

config AQM_UPLOAD_INTERVAL_SEC
    int "Upload interval in seconds"
    default 1800
    help
      Interval between scheduled uploads (default: 30 minutes = 1800 seconds).

config AQM_UPLOAD_RETRY_COUNT
    int "Maximum upload retry attempts"
    default 3
    help
      Number of retry attempts before giving up on the current upload.

config AQM_UPLOAD_RETRY_BACKOFF_SEC
    int "Initial backoff delay between retries in seconds"
    default 30
    help
      Initial delay before first retry. Doubles on each subsequent retry.

endmenu

menu "MQTT Configuration"

config AQM_MQTT_BROKER_HOSTNAME
    string "MQTT broker hostname"
    default "mqtt.example.com"
    help
      Hostname or IP address of the MQTT broker.

config AQM_MQTT_BROKER_PORT
    int "MQTT broker port"
    default 8883
    help
      Port number for MQTT broker (8883 for TLS, 1883 for unencrypted).

config AQM_MQTT_CLIENT_ID_PREFIX
    string "MQTT client ID prefix"
    default "aqm_"
    help
      Prefix for MQTT client ID. Device IMEI will be appended.

config AQM_MQTT_TOPIC_DATA
    string "MQTT topic for sensor data"
    default "devices/%s/telemetry"
    help
      Topic for publishing sensor data. %s will be replaced with device ID.

config AQM_MQTT_TOPIC_LOGS
    string "MQTT topic for device logs"
    default "devices/%s/logs"
    help
      Topic for publishing diagnostic logs. %s will be replaced with device ID.

config AQM_MQTT_QOS
    int "MQTT Quality of Service level"
    default 1
    range 0 2
    help
      QoS 0 = At most once, QoS 1 = At least once, QoS 2 = Exactly once.

endmenu

menu "Logging Configuration"

config AQM_LOG_BUFFER_SIZE
    int "Number of persistent log entries"
    default 32
    help
      Maximum number of log entries stored in flash for remote diagnostics.

config AQM_LOG_UPLOAD_ON_CONNECT
    bool "Upload logs on every MQTT connection"
    default y
    help
      Automatically upload persistent logs when connecting to the broker.

endmenu

module = AQM
module-str = Air Quality Monitor
source "subsys/logging/Kconfig.template.log_config"
```

## prj.conf
```kconfig
# SPDX-License-Identifier: Apache-2.0
# Air Quality Monitor - Main Configuration

# ============================================================================
# GENERAL
# ============================================================================
CONFIG_HEAP_MEM_POOL_SIZE=4096
CONFIG_MAIN_STACK_SIZE=4096
CONFIG_SYSTEM_WORKQUEUE_STACK_SIZE=2048

# C++ Support
CONFIG_CPP=y
CONFIG_STD_CPP17=y
CONFIG_GLIBCXX_LIBCPP=y
CONFIG_NEWLIB_LIBC=y

# ============================================================================
# LOGGING
# ============================================================================
CONFIG_LOG=y
CONFIG_LOG_MODE_DEFERRED=y
CONFIG_LOG_BUFFER_SIZE=4096
CONFIG_LOG_BACKEND_UART=y
CONFIG_LOG_DEFAULT_LEVEL=3

# ============================================================================
# DATE-TIME
# ============================================================================
CONFIG_DATE_TIME=y
CONFIG_DATE_TIME_MODEM=y
CONFIG_DATE_TIME_AUTO_UPDATE=y
CONFIG_DATE_TIME_UPDATE_INTERVAL_SECONDS=14400

# ============================================================================
# FLASH / NVS STORAGE
# ============================================================================
CONFIG_FLASH=y
CONFIG_FLASH_MAP=y
CONFIG_FLASH_PAGE_LAYOUT=y
CONFIG_NVS=y
CONFIG_NVS_LOG_LEVEL_WRN=y
CONFIG_SETTINGS=y
CONFIG_SETTINGS_NVS=y

# ============================================================================
# NETWORKING
# ============================================================================
CONFIG_NETWORKING=y
CONFIG_NET_SOCKETS=y
CONFIG_NET_SOCKETS_POSIX_NAMES=y
CONFIG_NET_NATIVE=n

# ============================================================================
# MODEM / LTE
# ============================================================================
CONFIG_NRF_MODEM_LIB=y
CONFIG_MODEM_KEY_MGMT=y
CONFIG_LTE_LINK_CONTROL=y
CONFIG_LTE_AUTO_INIT_AND_CONNECT=n

# PSM (Power Saving Mode)
CONFIG_LTE_PSM_REQ=y
CONFIG_LTE_PSM_REQ_RPTAU="00000110"
CONFIG_LTE_PSM_REQ_RAT="00000000"

# ============================================================================
# MQTT
# ============================================================================
CONFIG_MQTT_LIB=y
CONFIG_MQTT_LIB_TLS=y
CONFIG_MQTT_KEEPALIVE=120
CONFIG_MQTT_HELPER=y

# ============================================================================
# TLS / SECURITY
# ============================================================================
CONFIG_NET_SOCKETS_SOCKOPT_TLS=y
CONFIG_TLS_CREDENTIALS=y
CONFIG_MBEDTLS=y
CONFIG_MBEDTLS_TLS_VERSION_1_2=y
CONFIG_MBEDTLS_DTLS=n
CONFIG_MBEDTLS_SSL_MAX_CONTENT_LEN=4096

# ============================================================================
# CBOR (zcbor)
# ============================================================================
CONFIG_ZCBOR=y
CONFIG_ZCBOR_CANONICAL=y

# ============================================================================
# REBOOT / WATCHDOG
# ============================================================================
CONFIG_REBOOT=y

# ============================================================================
# APPLICATION SPECIFIC (defined in Kconfig)
# ============================================================================
CONFIG_AQM_SENSOR_INTERVAL_SEC=300
CONFIG_AQM_UPLOAD_INTERVAL_SEC=1800
CONFIG_AQM_BUFFER_SIZE=128
CONFIG_AQM_BUFFER_HIGH_WATER_PERCENT=80
CONFIG_AQM_MQTT_BROKER_HOSTNAME="mqtt.example.com"
CONFIG_AQM_MQTT_BROKER_PORT=8883
CONFIG_AQM_MQTT_CLIENT_ID_PREFIX="aqm_"
CONFIG_AQM_LOG_BUFFER_SIZE=32
```

## boards/nrf9160dk_nrf9160_ns.conf
```kconfig
# SPDX-License-Identifier: Apache-2.0
# Board-specific configuration for nRF9160 DK

# Use non-secure build (required for modem access)
CONFIG_BOARD_ENABLE_DCDC=y

# GPIO for LEDs/buttons (debugging)
CONFIG_GPIO=y
```

## boards/thingy91_nrf9160_ns.conf
```kconfig
# SPDX-License-Identifier: Apache-2.0
# Board-specific configuration for Thingy:91

# Use non-secure build (required for modem access)
CONFIG_BOARD_ENABLE_DCDC_APP=y
CONFIG_BOARD_ENABLE_DCDC_HV=y

# GPIO for LEDs
CONFIG_GPIO=y

# Thingy:91 has BME680 sensor - but we use stubs for this exercise
# CONFIG_SENSOR=y
# CONFIG_BME680=y
```

## src/main.cpp
```c
// Thread-based Air Quality Monitor
// Thread queue version instead of timer+work queue

#include <zephyr/kernel.h>
#include <zephyr/logging/log.h>
#include <date_time.h>

#include "types.hpp"
#include "Sensor.hpp"
#include "Buffer.hpp"
#include "Network.hpp"
#include "Mqtt.hpp"

LOG_MODULE_REGISTER(main, CONFIG_AQM_LOG_LEVEL);

// Each thread needs its own stack
K_THREAD_STACK_DEFINE(sensor_stack, 2048);
K_THREAD_STACK_DEFINE(upload_stack, 4096);

static struct k_thread sensor_thread;
static struct k_thread upload_thread;

// Semaphore to trigger early upload when buffer hits high water mark
static K_SEM_DEFINE(upload_trigger, 0, 1);

#define BATCH_SIZE 12

// ============================================================================
// SENSOR THREAD - reads sensor every 5 min
// ============================================================================

static void sensor_thread_fn(void *p1, void *p2, void *p3)
{
    ARG_UNUSED(p1);
    ARG_UNUSED(p2);
    ARG_UNUSED(p3);

    while (1) {
        SensorSample sample = {0};

        // Get timestamp
        int64_t now_ms;
        if (date_time_now(&now_ms) == 0) {
            sample.timestamp = now_ms / 1000;
        } else {
            sample.timestamp = k_uptime_get() / 1000;
        }

        // Read sensor
        int16_t temp;
        uint16_t humidity;
        if (g_sensor.read(&temp, &humidity)) {
            sample.temp_x100 = temp;
            sample.humidity_x100 = humidity;
            sample.flags = 0;
            LOG_INF("Sensor: %d.%02d C, %u.%02u %%",
                    temp / 100, abs(temp % 100),
                    humidity / 100, humidity % 100);
        } else {
            sample.flags = 1;
            LOG_WRN("Sensor error (count: %d)", g_sensor.get_error_count());
        }

        // Store in buffer
        g_buffer.push(&sample);
        LOG_DBG("Buffer: %d/%d samples", g_buffer.count(), g_buffer.capacity());

        // Trigger early upload if buffer getting full (80%)
        if (g_buffer.fill_percent() >= CONFIG_AQM_BUFFER_HIGH_WATER_PERCENT) {
            LOG_WRN("Buffer at %d%%, triggering early upload", g_buffer.fill_percent());
            k_sem_give(&upload_trigger);
        }

        // Sleep 5 minutes
        k_sleep(K_SECONDS(CONFIG_AQM_SENSOR_INTERVAL_SEC));
    }
}

// ============================================================================
// UPLOAD THREAD - uploads every 30 min or buffera triggers
// ============================================================================

static void upload_thread_fn(void *p1, void *p2, void *p3)
{
    ARG_UNUSED(p1);
    ARG_UNUSED(p2);
    ARG_UNUSED(p3);

    int failure_count = 0;

    while (1) {
        // Wait for 30 min timeout OR early trigger 
        k_sem_take(&upload_trigger, K_SECONDS(CONFIG_AQM_UPLOAD_INTERVAL_SEC));

        if (g_buffer.is_empty()) {
            continue;
        }

        LOG_INF("Starting upload (%d samples)", g_buffer.count());

        // Connect to LTE-M network
        if (g_network.connect() != 0) {
            LOG_ERR("Network unavailable");
            failure_count++;
            goto retry;
        }

        // Connect to MQTT broker
        if (g_mqtt.connect() != 0) {
            LOG_ERR("MQTT connect failed");
            g_network.disconnect();
            failure_count++;
            goto retry;
        }

        // Upload samples in batches
        {
            int uploaded = 0;
            while (!g_buffer.is_empty()) {
                SensorSample batch[BATCH_SIZE];
                size_t n = g_buffer.peek(batch, BATCH_SIZE);

                if (g_mqtt.publish(batch, n) == 0) {
                    g_buffer.pop(n);
                    uploaded += n;
                } else {
                    LOG_ERR("Publish failed, keeping %d samples", g_buffer.count());
                    break;
                }
            }

            g_mqtt.disconnect();
            g_network.disconnect();

            LOG_INF("Upload complete (%d samples sent)", uploaded);
            failure_count = 0;
            continue;
        }

retry:
        // Retry with backoff
        if (failure_count < CONFIG_AQM_UPLOAD_RETRY_COUNT) {
            int delay = CONFIG_AQM_UPLOAD_RETRY_BACKOFF_SEC * failure_count;
            LOG_WRN("Upload failed (%d), retry in %d sec", failure_count, delay);
            k_sleep(K_SECONDS(delay));
            k_sem_give(&upload_trigger);  // Re-trigger immediately after backoff
        } else {
            LOG_ERR("Upload retries exhausted, will try next interval");
            failure_count = 0;
        }
    }
}

// ============================================================================
// MAIN
// ============================================================================

int main(void)
{
    LOG_INF("========================================");
    LOG_INF("Air Quality Monitor v1.0 (thread version)");
    LOG_INF("Sensor interval: %d sec", CONFIG_AQM_SENSOR_INTERVAL_SEC);
    LOG_INF("Upload interval: %d sec", CONFIG_AQM_UPLOAD_INTERVAL_SEC);
    LOG_INF("Buffer size: %d samples", CONFIG_AQM_BUFFER_SIZE);
    LOG_INF("========================================");

    // Initialize
    g_sensor.init();
    g_buffer.init();
    g_network.init();
    g_mqtt.init();

    // Create sensor thread (priority 5)
    k_thread_create(&sensor_thread, sensor_stack,
                    K_THREAD_STACK_SIZEOF(sensor_stack),
                    sensor_thread_fn,
                    NULL, NULL, NULL,
                    5, 0, K_NO_WAIT);
    k_thread_name_set(&sensor_thread, "sensor");

    // Create upload thread (priority 7 - lower priority than sensor)
    k_thread_create(&upload_thread, upload_stack,
                    K_THREAD_STACK_SIZEOF(upload_stack),
                    upload_thread_fn,
                    NULL, NULL, NULL,
                    7, 0, K_NO_WAIT);
    k_thread_name_set(&upload_thread, "upload");

    LOG_INF("Threads started");

    // Main thread
    while (1) {
        if (g_sensor.get_error_count() >= 10) {
            LOG_ERR("Excessive sensor errors: %d", g_sensor.get_error_count());
        }

        k_sleep(K_SECONDS(60));
    }

    return 0;
}
```

## src/Buffer.cpp
```c
#include "Buffer.hpp"
#include <zephyr/kernel.h>
#include <zephyr/sys/ring_buffer.h>
#include <zephyr/logging/log.h>

LOG_MODULE_REGISTER(buffer, CONFIG_AQM_LOG_LEVEL);

cBuffer g_buffer;

// Zephyr ring buffer - stores raw bytes
#define MAX_SAMPLES CONFIG_AQM_BUFFER_SIZE
RING_BUF_DECLARE(sample_ring, MAX_SAMPLES * sizeof(SensorSample));

int cBuffer::init(void)
{
    ring_buf_reset(&sample_ring);
    count_ = 0;
    LOG_INF("Buffer init (capacity: %d samples)", MAX_SAMPLES);
    return 0;
}

int cBuffer::push(const SensorSample *sample)
{
    // If buffer full, drop oldest
    // Alternative would be rejecting new samples, but dropping oldest is better
    if (count_ >= MAX_SAMPLES) {
        SensorSample discard;
        ring_buf_get(&sample_ring, (uint8_t*)&discard, sizeof(discard));
        count_--;
        LOG_WRN("Buffer full, dropped oldest sample");
    }
    
    uint32_t written = ring_buf_put(&sample_ring, 
                                     (const uint8_t*)sample, 
                                     sizeof(SensorSample));
    if (written != sizeof(SensorSample)) {
        LOG_ERR("Buffer write failed");
        return -1;
    }
    
    count_++;
    return 0;
}

size_t cBuffer::peek(SensorSample *samples, size_t max_count)
{
    if (count_ == 0 || max_count == 0) {
        return 0;
    }
    
    size_t n = MIN(count_, max_count);
    uint32_t bytes = ring_buf_peek(&sample_ring, (uint8_t*)samples, 
                                    n * sizeof(SensorSample));
    return bytes / sizeof(SensorSample);
}

void cBuffer::pop(size_t count)
{
    SensorSample discard;
    for (size_t i = 0; i < count && count_ > 0; i++) {
        ring_buf_get(&sample_ring, (uint8_t*)&discard, sizeof(discard));
        count_--;
    }
}

void cBuffer::clear(void)
{
    ring_buf_reset(&sample_ring);
    count_ = 0;
    LOG_INF("Buffer cleared");
}

size_t cBuffer::capacity(void) const
{
    return MAX_SAMPLES;
}

int cBuffer::fill_percent(void) const
{
    return (count_ * 100) / MAX_SAMPLES;
}
```

## src/Buffer.hpp
```c
#ifndef BUFFER_HPP
#define BUFFER_HPP

#include "types.hpp"
#include <cstddef>

// Ring buffer - stores sensor samples in RAM, lost on reset. 
// Better solustion would be storing it in flash.

class cBuffer {
public:
    int    init(void);
    int    push(const SensorSample *sample);
    size_t peek(SensorSample *samples, size_t max_count);
    void   pop(size_t count);
    void   clear(void);
    
    size_t count(void) const { return count_; }
    size_t capacity(void) const;
    bool   is_empty(void) const { return count_ == 0; }
    int    fill_percent(void) const;

private:
    size_t count_ = 0;
};

extern cBuffer g_buffer;

#endif // BUFFER_HPP
```

## src/Mqtt.cpp
```c
#include "Mqtt.hpp"
#include <zephyr/kernel.h>
#include <zephyr/logging/log.h>
#include <net/mqtt_helper.h>

LOG_MODULE_REGISTER(mqtt, CONFIG_AQM_LOG_LEVEL);

cMqtt g_mqtt;

// Semaphore to wait for CONNACK
static K_SEM_DEFINE(mqtt_connected_sem, 0, 1);

// MQTT event callbacks
static void on_mqtt_connack(enum mqtt_conn_return_code return_code)
{
    if (return_code == MQTT_CONNECTION_ACCEPTED) {
        LOG_INF("MQTT connected");
        k_sem_give(&mqtt_connected_sem);
    } else {
        LOG_ERR("MQTT connection rejected: %d", return_code);
    }
}

static void on_mqtt_disconnect(int result)
{
    LOG_INF("MQTT disconnected: %d", result);
}

static void on_mqtt_publish(struct mqtt_helper_buf topic, struct mqtt_helper_buf payload)
{
    // We don't subscribe, so this won't be called
    LOG_DBG("Received publish on topic: %.*s", topic.size, topic.ptr);
}

static void on_mqtt_suback(uint16_t message_id, int result)
{
    // We don't subscribe
}

int cMqtt::init(void)
{
    int err;

    LOG_INF("MQTT init");

    struct mqtt_helper_cfg cfg = {
        .cb = {
            .on_connack = on_mqtt_connack,
            .on_disconnect = on_mqtt_disconnect,
            .on_publish = on_mqtt_publish,
            .on_suback = on_mqtt_suback,
        },
    };

    err = mqtt_helper_init(&cfg);
    if (err) {
        LOG_ERR("mqtt_helper_init failed: %d", err);
        return err;
    }

    connected_ = false;
    return 0;
}

int cMqtt::connect(void)
{
    int err;

    if (connected_) {
        return 0;
    }

    LOG_INF("Connecting to MQTT broker %s:%d...",
            CONFIG_AQM_MQTT_BROKER_HOSTNAME,
            CONFIG_AQM_MQTT_BROKER_PORT);

    // Reset semaphore
    k_sem_reset(&mqtt_connected_sem);

    // Connection parameters
    struct mqtt_helper_conn_params params = {
        .hostname = {
            .ptr = CONFIG_AQM_MQTT_BROKER_HOSTNAME,
            .size = strlen(CONFIG_AQM_MQTT_BROKER_HOSTNAME),
        },
        .device_id = {
            .ptr = CONFIG_AQM_MQTT_CLIENT_ID_PREFIX,
            .size = strlen(CONFIG_AQM_MQTT_CLIENT_ID_PREFIX),
        },
    };

    err = mqtt_helper_connect(&params);
    if (err) {
        LOG_ERR("mqtt_helper_connect failed: %d", err);
        return err;
    }

    // Wait for CONNACK (timeout 30 seconds)
    err = k_sem_take(&mqtt_connected_sem, K_SECONDS(30));
    if (err) {
        LOG_ERR("MQTT connection timeout");
        mqtt_helper_disconnect();
        return -ETIMEDOUT;
    }

    connected_ = true;
    return 0;
}

void cMqtt::disconnect(void)
{
    if (!connected_) {
        return;
    }

    LOG_INF("MQTT disconnect");
    mqtt_helper_disconnect();
    connected_ = false;
}

int cMqtt::publish(const SensorSample *samples, size_t count)
{
    int err;

    if (!connected_) {
        return -ENOTCONN;
    }

    // topic: devices/{client_id}/telemetry
    static char topic[64];
    snprintf(topic, sizeof(topic), "devices/%s/telemetry",
             CONFIG_AQM_MQTT_CLIENT_ID_PREFIX);

    // Build simple JSON payload
    // Format: {"samples":[{"ts":123,"t":2200,"h":5500},...]}
    static char payload[512];
    int pos = 0;

    pos += snprintf(payload + pos, sizeof(payload) - pos, "{\"samples\":[");

    for (size_t i = 0; i < count && pos < sizeof(payload) - 50; i++) {
        if (i > 0) {
            pos += snprintf(payload + pos, sizeof(payload) - pos, ",");
        }
        pos += snprintf(payload + pos, sizeof(payload) - pos,
                        "{\"ts\":%lld,\"t\":%d,\"h\":%u,\"f\":%u}",
                        samples[i].timestamp,
                        samples[i].temp_x100,
                        samples[i].humidity_x100,
                        samples[i].flags);
    }

    pos += snprintf(payload + pos, sizeof(payload) - pos, "]}");

    LOG_DBG("Publishing to %s: %s", topic, payload);

    struct mqtt_publish_param param = {
        .message = {
            .topic = {
                .topic = {
                    .utf8 = topic,
                    .size = strlen(topic),
                },
                .qos = MQTT_QOS_1_AT_LEAST_ONCE,
            },
            .payload = {
                .data = payload,
                .len = strlen(payload),
            },
        },
        .message_id = mqtt_helper_msg_id_get(),
    };

    err = mqtt_helper_publish(&param);
    if (err) {
        LOG_ERR("mqtt_helper_publish failed: %d", err);
        return err;
    }

    LOG_INF("Published %d samples", count);
    return 0;
}
```

## src/Mqtt.hpp
```c
#ifndef MQTT_HPP
#define MQTT_HPP

#include "types.hpp"
#include <cstddef>

// MQTT client for uploading sensor data
// TODO: Zephyrs MQTT library with TLS support, subcribing to topics, FOTA update using SDK libraries.
class cMqtt {
public:
    int  init(void);
    int  connect(void);
    void disconnect(void);
    int  publish(const SensorSample *samples, size_t count);
    
    bool is_connected(void) const { return connected_; }

private:
    bool connected_ = false;
};

extern cMqtt g_mqtt;

#endif // MQTT_HPP
```

## src/Network.cpp
```c
#include "Network.hpp"
#include <zephyr/kernel.h>
#include <zephyr/logging/log.h>
#include <modem/nrf_modem_lib.h>
#include <modem/lte_lc.h>

LOG_MODULE_REGISTER(network, CONFIG_AQM_LOG_LEVEL);

cNetwork g_network;

// Semaphore to wait for LTE connection
static K_SEM_DEFINE(lte_connected_sem, 0, 1);

static void lte_event_handler(const struct lte_lc_evt *const evt)
{
    switch (evt->type) {
    case LTE_LC_EVT_NW_REG_STATUS:
        if (evt->nw_reg_status == LTE_LC_NW_REG_REGISTERED_HOME ||
            evt->nw_reg_status == LTE_LC_NW_REG_REGISTERED_ROAMING) {
            LOG_INF("Connected to LTE network");
            k_sem_give(&lte_connected_sem);
        }
        break;
    case LTE_LC_EVT_PSM_UPDATE:
        LOG_INF("PSM parameter update: TAU: %d, Active time: %d",
                evt->psm_cfg.tau, evt->psm_cfg.active_time);
        break;
    case LTE_LC_EVT_RRC_UPDATE:
        LOG_INF("RRC mode: %s",
                evt->rrc_mode == LTE_LC_RRC_MODE_CONNECTED ? "Connected" : "Idle");
        break;
    default:
        break;
    }
}

int cNetwork::init(void)
{
    int err;

    LOG_INF("Initializing modem...");

    err = nrf_modem_lib_init();
    if (err) {
        LOG_ERR("Modem init failed: %d", err);
        return err;
    }

    lte_lc_register_handler(lte_event_handler);

    connected_ = false;
    LOG_INF("Modem initialized");
    return 0;
}

int cNetwork::connect(void)
{
    int err;

    if (connected_) {
        return 0;
    }

    LOG_INF("Connecting to LTE-M network...");

    // Reset semaphore
    k_sem_reset(&lte_connected_sem);

    // Start LTE connection
    err = lte_lc_connect();
    if (err) {
        LOG_ERR("LTE connect failed: %d", err);
        return err;
    }

    // Wait for connection
    err = k_sem_take(&lte_connected_sem, K_SECONDS(60));
    if (err) {
        LOG_ERR("LTE connection timeout");
        return -ETIMEDOUT;
    }

    connected_ = true;
    return 0;
}

void cNetwork::disconnect(void)
{
    if (!connected_) {
        return;
    }

    LOG_INF("Releasing network (PSM will handle sleep)");
    
    //TODO: Should be handled by PSM. Not sure, must be checked
    
    connected_ = false;
}
```

## src/Network.hpp
```c
#ifndef NETWORK_HPP
#define NETWORK_HPP

// LTE-M network controller
class cNetwork {
public:
    int  init(void);
    int  connect(void);
    void disconnect(void);
    
    bool is_connected(void) const { return connected_; }

private:
    bool connected_ = false;
};

extern cNetwork g_network;

#endif // NETWORK_HPP
```

## src/Sensor.cpp
```c
#include "Sensor.hpp"
#include <zephyr/kernel.h>
#include <zephyr/logging/log.h>

LOG_MODULE_REGISTER(sensor, CONFIG_AQM_LOG_LEVEL);

cSensor g_sensor;

// Test data array - goes thru some valid readings and simulated errors
// I2C or SPI initialization and received data handler should be implemented
static const struct {
    int16_t  temp;
    uint16_t humidity;
    bool     error;
} test_data[] = {
    { 2200, 5500, false },  // 22.00°C, 55%
    { 2250, 5400, false },
    { 2180, 5600, false },
    { -1,   0,    true  },  // Simulated sensor failure
    { 2300, 5200, false },
    { 2150, 5800, false },
};

int cSensor::init(void)
{
    LOG_INF("Sensor init");
    // Initialize I2C or SPI in here. Check sensor connection etc. The state of initialization would be returned. 
    initialized_ = true;
    test_index_ = 0;
    error_count_ = 0;
    return 0;
}

bool cSensor::read(int16_t *temp_x100, uint16_t *humidity_x100)
{
    if (!initialized_) {
        return false;
    }
    
    // Get next test value
    int idx = test_index_ % ARRAY_SIZE(test_data);
    test_index_++;
    
    if (test_data[idx].error) {
        error_count_++;
        LOG_WRN("Sensor read failed (simulated)");
        return false;
    }
    
    *temp_x100 = test_data[idx].temp;
    *humidity_x100 = test_data[idx].humidity;
    
    // Reset error count on successful read
    error_count_ = 0;
    return true;
}
```

## src/Sensor.hpp
```c
#ifndef SENSOR_HPP
#define SENSOR_HPP

#include "types.hpp"

// Sensor driver - reads temperature and hummidity
// Sensor data stubbed 
class cSensor {
public:
    int  init(void);
    bool read(int16_t *temp_x100, uint16_t *humidity_x100);
    
    uint32_t get_error_count(void) const { return error_count_; }

private:
    bool initialized_ = false;
    int  test_index_ = 0;
    uint32_t error_count_ = 0;
};

extern cSensor g_sensor;

#endif // SENSOR_HPP
```

## src/Uploader.cpp
```c
#include "Uploader.hpp"
#include "Buffer.hpp"
#include "Network.hpp"
#include "Mqtt.hpp"
#include <zephyr/kernel.h>
#include <zephyr/logging/log.h>

LOG_MODULE_REGISTER(uploader, CONFIG_AQM_LOG_LEVEL);

// Global instance
cUploader g_uploader;

// Zephyr timer and work item (must be static/global)
K_TIMER_DEFINE(upload_timer, cUploader::timer_handler, NULL);
K_WORK_DEFINE(upload_work, cUploader::work_handler);

// Max samples per MQTT message
#define BATCH_SIZE 12

int cUploader::init(void)
{
    LOG_INF("Uploader init (interval: %d sec)", CONFIG_AQM_UPLOAD_INTERVAL_SEC);
    failure_count_ = 0;
    return 0;
}

void cUploader::start(void)
{
    if (running_) return;
    
    running_ = true;
    k_timer_start(&upload_timer,
                  K_SECONDS(CONFIG_AQM_UPLOAD_INTERVAL_SEC),
                  K_SECONDS(CONFIG_AQM_UPLOAD_INTERVAL_SEC));
    LOG_INF("Upload task started");
}

void cUploader::stop(void)
{
    if (!running_) return;
    
    running_ = false;
    k_timer_stop(&upload_timer);
    LOG_INF("Upload task stopped");
}

void cUploader::trigger(void)
{
    // Schedule immediate upload
    k_work_submit(&upload_work);
}

void cUploader::timer_handler(struct k_timer *timer)
{
    ARG_UNUSED(timer);
    // Timer runs in ISR context - just schedule work
    k_work_submit(&upload_work);
}

void cUploader::work_handler(struct k_work *work)
{
    ARG_UNUSED(work);
    
    int ret = g_uploader.do_upload();
    
    if (ret != 0) {
        g_uploader.failure_count_++;
        LOG_WRN("Upload failed (%d consecutive)", g_uploader.failure_count_);
        
        // Retry with backoff
        if (g_uploader.failure_count_ < CONFIG_AQM_UPLOAD_RETRY_COUNT) {
            int delay = CONFIG_AQM_UPLOAD_RETRY_BACKOFF_SEC * g_uploader.failure_count_;
            LOG_INF("Retry in %d seconds", delay);
            k_timer_start(&upload_timer, K_SECONDS(delay), 
                         K_SECONDS(CONFIG_AQM_UPLOAD_INTERVAL_SEC));
        } else {
            LOG_ERR("Upload retries exhausted, will try next interval");
            g_uploader.failure_count_ = 0;
        }
    } else {
        g_uploader.failure_count_ = 0;
    }
}

int cUploader::do_upload(void)
{
    if (g_buffer.is_empty()) {
        LOG_DBG("Nothing to upload");
        return 0;
    }
    
    LOG_INF("Starting upload (%d samples)", g_buffer.count());
    
    // Connect to LTE-M network
    if (g_network.connect() != 0) {
        LOG_ERR("Network unavailable");
        return -1;
    }
    
    // Connect to MQTT broker
    if (g_mqtt.connect() != 0) {
        g_network.disconnect();
        return -1;
    }
    
    // Upload samples in batches
    int uploaded = 0;
    while (!g_buffer.is_empty()) {
        SensorSample batch[BATCH_SIZE];
        size_t n = g_buffer.peek(batch, BATCH_SIZE);
        
        if (g_mqtt.publish(batch, n) == 0) {
            g_buffer.pop(n);  // Only pop if the publish was successful
            uploaded += n;
        } else {
            LOG_ERR("Publish failed, keeping %d samples", g_buffer.count());
            break;
        }
    }
    
    // Cleanup
    g_mqtt.disconnect();
    g_network.disconnect();
    
    LOG_INF("Upload complete (%d samples sent)", uploaded);
    return (uploaded > 0) ? 0 : -1;
}
```

## src/Uploader.hpp
```c
#ifndef UPLOADER_HPP
#define UPLOADER_HPP

#include <cstdint>

class cUploader {
public:
    int  init(void);
    void start(void);
    void stop(void);
    
    // Trigger immediate upload (when buffer is full or some other event added later)
    void trigger(void);
    
    uint32_t get_failure_count(void) const { return failure_count_; }

private:
    static void timer_handler(struct k_timer *timer);
    static void work_handler(struct k_work *work);
    
    int do_upload(void);
    
    bool running_ = false;
    uint32_t failure_count_ = 0;
};

extern cUploader g_uploader;

#endif // UPLOADER_HPP
```

## src/types.hpp
```c
#ifndef TYPES_HPP
#define TYPES_HPP

#include <cstdint>

// Sensor sample - 16 bytes total
struct SensorSample {
    int64_t  timestamp;      // Unix time in seconds
    int16_t  temp_x100;      // Temperature * 100 (e.g., 2250 = 22.50°C)
    uint16_t humidity_x100;  // Humidity * 100 (e.g., 5500 = 55.00%)
    uint8_t  flags;          // 0=OK, 1=sensor error
    uint8_t  reserved[3];    // Padding for alignment
};

#endif // TYPES_HPP
```
